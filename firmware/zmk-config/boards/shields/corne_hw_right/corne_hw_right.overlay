#include "corne_hw_left.overlay"

&default_transform {
    col-offset = <6>;
};

&kscan0 {
    // Ряды правой половины со схемы (029, 113, 010, 009)
    row-gpios = <&gpio0 29 GPIO_ACTIVE_HIGH>,
                <&gpio1 13 GPIO_ACTIVE_HIGH>,
                <&gpio0 10 GPIO_ACTIVE_HIGH>,
                <&gpio0 9  GPIO_ACTIVE_HIGH>;

    // Колонки правой половины со схемы (106, 104, 011, 100, 024, 022)
    col-gpios = <&gpio1 6  (GPIO_ACTIVE_HIGH | GPIO_PULL_DOWN)>,
                <&gpio1 4  (GPIO_ACTIVE_HIGH | GPIO_PULL_DOWN)>,
                <&gpio0 11 (GPIO_ACTIVE_HIGH | GPIO_PULL_DOWN)>,
                <&gpio1 0  (GPIO_ACTIVE_HIGH | GPIO_PULL_DOWN)>,
                <&gpio0 24 (GPIO_ACTIVE_HIGH | GPIO_PULL_DOWN)>,
                <&gpio0 22 (GPIO_ACTIVE_HIGH | GPIO_PULL_DOWN)>;
};
