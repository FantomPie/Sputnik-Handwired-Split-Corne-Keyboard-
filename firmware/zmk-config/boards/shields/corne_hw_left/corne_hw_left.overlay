#include <dt-bindings/zmk/matrix_transform.h>

/ {
    chosen {
        zmk,kscan = &kscan0;
        zmk,matrix-transform = &default_transform;
    };

    default_transform: matrix_transform {
        compatible = "zmk,matrix-transform";
        columns = <12>;
        rows = <4>;
        
        map = <
            0  1  2  3  4  5       6  7  8  9 10 11
           12 13 14 15 16 17      18 19 20 21 22 23
           24 25 26 27 28 29      30 31 32 33 34 35
                      39 40 41    42 43 44
        >;
    };

    kscan0: kscan {
        compatible = "zmk,kscan-gpio-matrix";

        row-gpios = <&gpio1 0  GPIO_ACTIVE_HIGH>,
                    <&gpio0 11 GPIO_ACTIVE_HIGH>,
                    <&gpio1 4  GPIO_ACTIVE_HIGH>,
                    <&gpio1 6  GPIO_ACTIVE_HIGH>;

        col-gpios = <&gpio0 2  (GPIO_ACTIVE_HIGH | GPIO_PULL_DOWN)>,
                    <&gpio1 15 (GPIO_ACTIVE_HIGH | GPIO_PULL_DOWN)>,
                    <&gpio1 13 (GPIO_ACTIVE_HIGH | GPIO_PULL_DOWN)>,
                    <&gpio1 11 (GPIO_ACTIVE_HIGH | GPIO_PULL_DOWN)>,
                    <&gpio0 10 (GPIO_ACTIVE_HIGH | GPIO_PULL_DOWN)>,
                    <&gpio0 9  (GPIO_ACTIVE_HIGH | GPIO_PULL_DOWN)>;

        diode-direction = "row2col";
        debounce-press-ms = <5>;
        debounce-release-ms = <5>;
        wakeup-source;
    };
};
